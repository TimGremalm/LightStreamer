## main/Kconfig.projbuild
```kconfig
menu "Light Streamer Configuration"

    config ESP_WIFI_SSID
        string "WiFi SSID"
        default "myssid"
        help
            SSID (network name) for the example to connect to.

    config ESP_WIFI_PASSWORD
        string "WiFi Password"
        default "mypassword"
        help
            WiFi password (WPA or WPA2) for the example to use.

    config ESP_MAXIMUM_RETRY
        int "Maximum retry"
        default 5
        help
            Set the Maximum retry to avoid station reconnecting to the AP unlimited when the AP is really inexistent.

    config I2C_MASTER_SCL
        int "SCL GPIO Num"
        default 19
        help
            GPIO number for I2C Master clock line.

    config I2C_MASTER_SDA
        int "SDA GPIO Num"
        default 18
        help
            GPIO number for I2C Master data line.

    config BROKER_URL
        string "MQTT Broker URL"
        default "mqtt://192.168.0.1"
        help
            URL of the MQTT broker to connect to

endmenu
```
